## ubuntu/Kconfig
```kconfig
menu "Ubuntu Supplied Third-Party Device Drivers"

##
##
##
source "ubuntu/dm-raid4-5/Kconfig"
##
##
##
source "ubuntu/ndiswrapper/Kconfig"
##
##
##
source "ubuntu/rfkill/Kconfig"
##
##
##
##
##
##

endmenu
```

## ubuntu/fsam7400/Kconfig
```kconfig
config FSAM7400
	tristate "SW RF kill switch for Fujitsu Siemens Amilo M 7400"
	depends on X86
	select CHECK_SIGNATURE
	default m
	---help---
```
